&vik_i2c {
	status = "okay";

	trackpad: maxtouch@4a {
		compatible = "microchip,maxtouch";
		reg = <0x4a>;
		chg-gpios = <&vik_conn 3 (GPIO_ACTIVE_LOW | GPIO_PULL_UP)>;
		active-acq-time-ms = <255>;
		sensor-width = <42>;
		sensor-height= <50>;
		touch_threshold = <20>;
		touch_hysteresis = <10>;
		internal_touch_threshold = <10>;
		internal_touch_hysteresis = <5>;
		gain = <10>;
		allowed_measurement_types = <3>;
		swap-xy;
		repeat-each-cycle;
		retransmission_compensation_disable;
	};
};

/ {
	trackpad_listener {
		compatible = "zmk,input-listener";
		mode = "trackpad";
		device = <&trackpad>;
	};
};
