// Copyright (c) 2023 The ZMK Contributors
// SPDX-License-Identifier: MIT

#include <behaviors.dtsi>
#include <dt-bindings/zmk/keys.h>


/ {
    keymap {
        compatible = "zmk,keymap";

        base {
            bindings = <
&bootloader
            >;
        };
    };
};
